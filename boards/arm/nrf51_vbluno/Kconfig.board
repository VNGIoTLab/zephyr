## boards/arm/nrf51_vbluno/Kconfig.board
```kconfig
# Kconfig - nRF51 Repeater V3 board configuration
#
# Copyright (c) 2016 Linaro Limited.
#
# SPDX-License-Identifier: Apache-2.0

config BOARD_NRF51_VBLUNO
	bool "nRF51 VNG VBLUNO"
	depends on SOC_NRF51822_QFAC
```
